## modules/button/drivers/button_driver/Kconfig
```kconfig
# Create a new option in menuconfig

config CUSTOM_DRIVERS_BUTTON
    bool "Enable custom button driver"
    default n
    depends on GPIO
    help
      This option enables the custom button driver module.
      If enabled, the button driver will be included in the build.
      If disabled, the default button driver will be used instead.
```

## modules/button/dts/bindings/input/custom,button.yaml
```yaml
# yaml-language-server: $schema=https://docs.zephyrproject.org/latest/_static/dts/bindings/schemas/base.yaml#

description: Custom GPIO-based button device.

compatible: "custom,button"

properties:
  reg:
    type: int
    required: true
    description: The device's address on the bus.

  gpios:
    type: phandle-array
    required: true
    description: |
      The GPIO specification for the button. This should include a phandle
      to the GPIO controller, the pin number, and the configuration flags
      (e.g., GPIO_ACTIVE_LOW).

  label:
    type: string
    description: A human-readable label for the button.
```

## modules/say_hello/Kconfig
```kconfig
# create a new option in Kconfig for the say_hello module

config SAY_HELLO
    bool "Basic print test to console"
    default n # Set the library to be disabled by default
    depends on PRINTK
    help
      Enable this option to include a simple print test that outputs
      "Hello, World!" to the console.

      This is useful for verifying that the console output is working
      correctly in your Zephyr application.
```
