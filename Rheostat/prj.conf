## CMakeLists.txt
```
# SPDX-License-Identifier: Apache-2.0

cmake_minimum_required(VERSION 3.20.0)

set(ZEPHYR_EXTRA_MODULES "${CMAKE_SOURCE_DIR}/../modules/say_hello")

find_package(Zephyr REQUIRED HINTS $ENV{ZEPHYR_BASE})
project(Rheostat)

target_sources(app PRIVATE src/main.c)
```

## prj.conf
```kconfig
CONFIG_GPIO=y

# for random generator
CONFIG_STACK_POINTER_RANDOM=0
CONFIG_TEST_RANDOM_GENERATOR=y
CONFIG_TIMER_RANDOM_GENERATOR=y
CONFIG_TEST_CSPRNG_GENERATOR=y

# for float number print
# -LIBC_ERRNO y
# -PICOLIBC_IO_FLOAT n
# -PICOLIBC_IO_LONG_LONG y
# -PICOLIBC_USE_MODULE n
# -PICOLIBC_USE_TOOLCHAIN y
CONFIG_NEWLIB_LIBC=y
CONFIG_PICOLIBC=n
CONFIG_CBPRINTF_FP_ALWAYS_A=n
CONFIG_CBPRINTF_N_SPECIFIER=y
CONFIG_ERRNO_IN_TLS=y
CONFIG_NEWLIB_LIBC_CUSTOM_SBRK=n
CONFIG_NEWLIB_LIBC_FLOAT_PRINTF=n
CONFIG_NEWLIB_LIBC_FLOAT_SCANF=n
CONFIG_NEWLIB_LIBC_HEAP_LISTENER=n
CONFIG_NEWLIB_LIBC_MIN_REQUIRED_HEAP_SIZE=8192
CONFIG_NEWLIB_LIBC_NANO=n

# for say_hello modules
CONFIG_SAY_HELLO=y

# for LM35 sensor
CONFIG_ADC=y
CONFIG_ADC_STM32=y

# for DHT11 sensor
CONFIG_SENSOR=y
CONFIG_DHT=y
CONFIG_SENSOR_LOG_LEVEL_DBG=y
CONFIG_SENSOR_INIT_PRIORITY=90
# CONFIG_SENSOR_ASYNC_API is not set
# CONFIG_SENSOR_INFO is not set
# CONFIG_DHT_LOCK_IRQS is not set

# LOG
CONFIG_LOG=y
```

## boards/uno3_shield.overlay
```dts
/*
 * Correct Device Tree Overlay Structure
 */

&adc1 {
	pinctrl-0 = <&adc1_in9_pb1>;
	pinctrl-names = "default";
	st,adc-clock-source = "SYNC";
	st,adc-prescaler = <4>;
	status = "okay";

	#address-cells = <1>;
	#size-cells = <0>;

	channel@9 {
		reg = <9>;
		zephyr,gain = "ADC_GAIN_1";
		zephyr,reference = "ADC_REF_INTERNAL";
		zephyr,acquisition-time = <ADC_ACQ_TIME_DEFAULT>;
		zephyr,resolution = <12>;
		zephyr,vref-mv = <3300>;
	};
};
```

## src/main.c
```c
#include <zephyr/kernel.h>
#include <zephyr/device.h>
#include <zephyr/drivers/adc.h>
#include <zephyr/logging/log.h>

LOG_MODULE_REGISTER(Rheostat);

#define ADC_RESOLUTION 12
#define ADC_MAX 4095
#define ADC_CHANNEL 9      // PB1 = ADC1_IN9
#define VREF_MV 3300        // STM32 VCC in mV

void main(void)
{
    const struct device *adc_dev = DEVICE_DT_GET(DT_NODELABEL(adc1));
    if (!device_is_ready(adc_dev)) {
        LOG_ERR("ADC device not ready!");
        return;
    }

    int16_t sample;

    const struct adc_channel_cfg channel_cfg = {
        .gain = ADC_GAIN_1,
        .reference = ADC_REF_INTERNAL,
        .acquisition_time = ADC_ACQ_TIME_DEFAULT,
        .channel_id = ADC_CHANNEL,
        .differential = 0,
    };

    adc_channel_setup(adc_dev, &channel_cfg);

    while (1) {
        struct adc_sequence seq = {
            .channels = BIT(ADC_CHANNEL),
            .buffer = &sample,
            .buffer_size = sizeof(sample),
            .resolution = ADC_RESOLUTION,
        };

        if (adc_read(adc_dev, &seq) == 0) {
            LOG_INF("Sample=%d", sample);
        } else {
            LOG_WRN("ADC read failed");
        }

        k_sleep(K_SECONDS(1));
    }
}
```
