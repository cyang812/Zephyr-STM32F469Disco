## CMakeLists.txt
```
# SPDX-License-Identifier: Apache-2.0

cmake_minimum_required(VERSION 3.20.0)

set(ZEPHYR_EXTRA_MODULES "${CMAKE_SOURCE_DIR}/../modules/say_hello")

find_package(Zephyr REQUIRED HINTS $ENV{ZEPHYR_BASE})
project(dht11)

target_sources(app PRIVATE src/main.c)
```

## prj.conf
```kconfig
CONFIG_GPIO=y

# for random generator
CONFIG_STACK_POINTER_RANDOM=0
CONFIG_TEST_RANDOM_GENERATOR=y
CONFIG_TIMER_RANDOM_GENERATOR=y
CONFIG_TEST_CSPRNG_GENERATOR=y

# for float number print
# -LIBC_ERRNO y
# -PICOLIBC_IO_FLOAT n
# -PICOLIBC_IO_LONG_LONG y
# -PICOLIBC_USE_MODULE n
# -PICOLIBC_USE_TOOLCHAIN y
CONFIG_NEWLIB_LIBC=y
CONFIG_PICOLIBC=n
CONFIG_CBPRINTF_FP_ALWAYS_A=n
CONFIG_CBPRINTF_N_SPECIFIER=y
CONFIG_ERRNO_IN_TLS=y
CONFIG_NEWLIB_LIBC_CUSTOM_SBRK=n
CONFIG_NEWLIB_LIBC_FLOAT_PRINTF=n
CONFIG_NEWLIB_LIBC_FLOAT_SCANF=n
CONFIG_NEWLIB_LIBC_HEAP_LISTENER=n
CONFIG_NEWLIB_LIBC_MIN_REQUIRED_HEAP_SIZE=8192
CONFIG_NEWLIB_LIBC_NANO=n

# for say_hello modules
CONFIG_SAY_HELLO=y

CONFIG_LOG=y
CONFIG_LOG_DEFAULT_LEVEL=3

# for DHT11 sensor
CONFIG_SENSOR=y
CONFIG_DHT=y
CONFIG_SENSOR_LOG_LEVEL_DBG=y
CONFIG_SENSOR_INIT_PRIORITY=90

# CONFIG_SENSOR_ASYNC_API is not set
# CONFIG_SENSOR_INFO is not set
# CONFIG_DHT_LOCK_IRQS is not set
```

## boards/uno3_shield.overlay
```dts
/ {

    sensors {
        dht11_0: dht11 {
            compatible = "aosong,dht";

            /* The init state of GPIO must be low, otherwise, fetch data failed with -5, EIO */
            dio-gpios = <&gpiog 12 (GPIO_ACTIVE_LOW | GPIO_PULL_UP)>;

            label = "DHT_SENSOR";
        };
    };

    aliases {
        dht11 = &dht11_0;
    };
};
```

## src/main.c
```c
/*
 * @Author: AIPC cy950812@gmail.com
 * @Date: 2025-08-16 22:25:06
 * @LastEditors: AIPC cy950812@gmail.com
 * @LastEditTime: 2025-08-25 20:05:42
 * @FilePath: _myapp_DHT11_src_main.c
 * @Description:
 *
 * Copyright (c) 2025 by AIPC, All Rights Reserved.
 */
/*
 * Copyright (c) 2016 Intel Corporation
 *
 * SPDX-License-Identifier: Apache-2.0
 */

#include <stdio.h>
#include <zephyr/kernel.h>
#include <zephyr/drivers/gpio.h>
#include <zephyr/drivers/sensor.h>

/* 1000 msec = 1 sec */
#define SLEEP_TIME_MS   3000
#define LED0_NODE DT_ALIAS(led0)

static const struct gpio_dt_spec led0 = GPIO_DT_SPEC_GET(LED0_NODE, gpios);

static const struct device *dht11 = DEVICE_DT_GET(DT_ALIAS(dht11));

int main(void)
{
    int ret;

    if (!gpio_is_ready_dt(&led0)) {
		return 0;
	}

	ret = gpio_pin_configure_dt(&led0, GPIO_OUTPUT_ACTIVE);
	if (ret < 0) {
		return 0;
	}

    if (!device_is_ready(dht11)) {
        printk("DHT11 device not ready\n");
        return;
    }

    k_msleep(SLEEP_TIME_MS);

    while (1) {

        gpio_pin_toggle_dt(&led0);

        ret = sensor_sample_fetch(dht11);
        if (ret == 0) {
            struct sensor_value temp, hum;
            sensor_channel_get(dht11, SENSOR_CHAN_AMBIENT_TEMP, &temp);
            sensor_channel_get(dht11, SENSOR_CHAN_HUMIDITY, &hum);

            printk("Temp: %d.%06d °C, Hum: %d.%06d %%\n",
                temp.val1, temp.val2,
                hum.val1, hum.val2);
        } else {
            printk("DHT11 sample fetch failed, %d\n", ret);
        }

        k_msleep(SLEEP_TIME_MS);
    }

    return 0;
}
```
