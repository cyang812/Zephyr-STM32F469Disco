## CMakeLists.txt
```
# SPDX-License-Identifier: Apache-2.0

cmake_minimum_required(VERSION 3.20.0)

set(ZEPHYR_EXTRA_MODULES "${CMAKE_SOURCE_DIR}/../modules/say_hello")

find_package(Zephyr REQUIRED HINTS $ENV{ZEPHYR_BASE})
project(blinky)

target_sources(app PRIVATE src/main.c)
```

## prj.conf
```kconfig
CONFIG_GPIO=y

# for random generator
CONFIG_STACK_POINTER_RANDOM=0
CONFIG_TEST_RANDOM_GENERATOR=y
CONFIG_TIMER_RANDOM_GENERATOR=y
CONFIG_TEST_CSPRNG_GENERATOR=y

# for float number print
# -LIBC_ERRNO y
# -PICOLIBC_IO_FLOAT n
# -PICOLIBC_IO_LONG_LONG y
# -PICOLIBC_USE_MODULE n
# -PICOLIBC_USE_TOOLCHAIN y
CONFIG_NEWLIB_LIBC=y
CONFIG_PICOLIBC=n
CONFIG_CBPRINTF_FP_ALWAYS_A=n
CONFIG_CBPRINTF_N_SPECIFIER=y
CONFIG_ERRNO_IN_TLS=y
CONFIG_NEWLIB_LIBC_CUSTOM_SBRK=n
CONFIG_NEWLIB_LIBC_FLOAT_PRINTF=n
CONFIG_NEWLIB_LIBC_FLOAT_SCANF=n
CONFIG_NEWLIB_LIBC_HEAP_LISTENER=n
CONFIG_NEWLIB_LIBC_MIN_REQUIRED_HEAP_SIZE=8192
CONFIG_NEWLIB_LIBC_NANO=n

# for say_hello modules
CONFIG_SAY_HELLO=y
```

## my_prj.conf
```kconfig
CONFIG_CBPRINTF_N_SPECIFIER=y
CONFIG_ERRNO_IN_TLS=y
CONFIG_NEWLIB_LIBC=y
CONFIG_NEWLIB_LIBC_MIN_REQUIRED_HEAP_SIZE=8192
```

## src/main.c
```c
/*
 * @Author: AIPC cy950812@gmail.com
 * @Date: 2025-08-16 22:25:06
 * @LastEditors: AIPC cy950812@gmail.com
 * @LastEditTime: 2025-08-17 15:08:44
 * @FilePath: _zephyr_stm32f469i_zephyr_samples_myapp_random_src_main.c
 * @Description:
 *
 * Copyright (c) 2025 by AIPC, All Rights Reserved.
 */
/*
 * Copyright (c) 2016 Intel Corporation
 *
 * SPDX-License-Identifier: Apache-2.0
 */

#include <stdio.h>
#include <zephyr/kernel.h>
#include <zephyr/drivers/gpio.h>
#include <zephyr/random/random.h>

#include "say_hello.h"

/* 1000 msec = 1 sec */
#define SLEEP_TIME_MS   1000

/* The devicetree node identifier for the "led0" alias. */
#define LED0_NODE DT_ALIAS(led0)

/*
 * A build error on this line means your board is unsupported.
 * See the sample documentation for information on how to fix this.
 */
static const struct gpio_dt_spec led = GPIO_DT_SPEC_GET(LED0_NODE, gpios);

int main(void)
{
	int ret;
	bool led_state = true;

	if (!gpio_is_ready_dt(&led)) {
		return 0;
	}

	ret = gpio_pin_configure_dt(&led, GPIO_OUTPUT_ACTIVE);
	if (ret < 0) {
		return 0;
	}

	while (1) {
		ret = gpio_pin_toggle_dt(&led);
		if (ret < 0) {
			return 0;
		}

		led_state = !led_state;
		printf("LED state: %s\n", led_state ? "ON" : "OFF");

		uint32_t random_value = sys_rand32_get();
		printf("Random value: %u\n", random_value);

		double random_double = ((double)random_value / UINT32_MAX + 1.0);
		printf("Random double: %f\n", random_double);

		say_hello();

		k_msleep(SLEEP_TIME_MS);
	}
	return 0;
}
```
